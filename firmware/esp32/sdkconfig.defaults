## firmware/esp32/sdkconfig.defaults
```kconfig
CONFIG_IDF_TARGET="esp32"
CONFIG_ESPTOOLPY_FLASHSIZE_4MB=y
CONFIG_PARTITION_TABLE_SINGLE_APP_LARGE=y
CONFIG_APP_PROJECT_VER_FROM_CONFIG=n
# 蓝牙：第一阶段只用 BLE（Bluedroid），第二阶段再打开经典蓝牙 HFP
# GATT 服务端必须打开：iPhone 会作为客户端读 ESP32 的 GAP/GATT 服务，没有回应会在 30 秒后断开
CONFIG_BT_ENABLED=y
CONFIG_BT_BLUEDROID_ENABLED=y
CONFIG_BT_CONTROLLER_ENABLED=y
CONFIG_BTDM_CTRL_MODE_BTDM=y
CONFIG_BT_BLE_ENABLED=y
CONFIG_BT_GATTC_ENABLE=y
CONFIG_BT_GATTS_ENABLE=y
CONFIG_BT_BLE_SMP_ENABLE=y
CONFIG_BT_CLASSIC_ENABLED=y
CONFIG_BT_SSP_ENABLED=y
# 免提（HFP 客户端），音频经 HCI 交给程序（之后转发到电脑）；支持宽带语音 mSBC 16k
CONFIG_BT_HFP_ENABLE=y
CONFIG_BT_HFP_CLIENT_ENABLE=y
CONFIG_BT_HFP_AUDIO_DATA_PATH_HCI=y
CONFIG_BT_HFP_WBS_ENABLE=y
CONFIG_BTDM_CTRL_BR_EDR_MAX_SYNC_CONN=1
CONFIG_BTDM_CTRL_BR_EDR_SCO_DATA_PATH_HCI=y
CONFIG_BTDM_CTRL_BR_EDR_MAX_ACL_CONN=2
# 串口给电脑用：日志只保留警告以上
CONFIG_LOG_DEFAULT_LEVEL_WARN=y
CONFIG_BOOTLOADER_LOG_LEVEL_WARN=y
CONFIG_BT_LOG_GAP_TRACE_LEVEL_WARNING=y
CONFIG_ESP_CONSOLE_UART_DEFAULT=y
CONFIG_ESP_CONSOLE_UART_BAUDRATE=115200
CONFIG_BT_HFP_AG_ENABLE=n
```
